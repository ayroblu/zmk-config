## config/west.yml
```yaml
manifest:
  remotes:
    - name: zmkfirmware
      # url-base: https://github.com/ayroblu
      url-base: https://github.com/zmkfirmware
  projects:
    - name: zmk
      remote: zmkfirmware
      # revision: PR-2188
      revision: v0.2
      import: app/west.yml
  self:
    path: config
```
